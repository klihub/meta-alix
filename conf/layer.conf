## conf/layer.conf
```bitbake
# We have a conf and classes directory, add to BBPATH
BBPATH .= ":${LAYERDIR}"

# We have a recipes-* directories, add to BBFILES
BBFILES += "${LAYERDIR}/recipes-*/*/*.bb \
	${LAYERDIR}/recipes-*/*/*.bbappend"

BBFILE_COLLECTIONS += "alix"
BBFILE_PATTERN_alix = "^${LAYERDIR}/"
BBFILE_PRIORITY_alix = "6"

META_ALIX_BASE := "${LAYERDIR}"

SUPPORTED_RECIPES_append = "${META_ALIX_BASE}/conf/distro/supported-recipes.txt"

LAYERSERIES_COMPAT_alix = "dunfell"
```

## conf/machine/alix.conf
```bitbake
#@TYPE: Machine
#@NAME: alix

#@DESCRIPTION: Machine configuration for PCEngines alix systems

PREFERRED_PROVIDER_virtual/kernel ?= "linux-yocto"
PREFERRED_VERSION_linux-yocto ?= "4.12%"

require conf/machine/include/tune-geode.inc
require conf/machine/include/geode-base.inc

MACHINE_FEATURES += "rtc serial wifi ext2 ext3 vfat "

MACHINE_EXTRA_RRECOMMENDS += "linux-firmware"

GLIBC_ADDONS = "nptl"
```

## conf/machine/include/geode-base.inc
```bitbake
#
# Base machine settings for a Geode (LX) X86-compatible architecture BSPs
#

#
# common settings for Geode (LX) machines
#
MACHINE_FEATURES += "pci x86 acpi"

MACHINE_EXTRA_RRECOMMENDS += "kernel-modules"

IMAGE_FSTYPES ?= "live"
NOISO ?= "1"

KERNEL_IMAGETYPE ?= "bzImage"

SERIAL_CONSOLE ?= "38400 ttyS0"

#
# kernel-related variables
#
PREFERRED_PROVIDER_virtual/kernel ??= "linux-yocto"
PREFERRED_VERSION_linux-yocto ??= "4.12%"
```

## conf/machine/include/tune-geode.inc
```bitbake
# Machine tuning settings for the Geode LX x86-compatible CPU architecure.

DEFAULTTUNE ?= "geode"

require conf/machine/include/x86/arch-x86.inc

# Extra tune features
#
# According to Net folklore (mostly http://wiki.laptop.org/go/Geode and
# https://gcc.gnu.org/bugzilla/show_bug.cgi?id=41989), the gcc 'geode'
# march and mtune settings are actually meant/optimised for the Geode LX,
# so we go'll with that... A suggested good enough alternative for gcc
# would be "-Os -mcpu=pentiumpro -mtune=generic".

TUNEVALID[geode] = "Enable Geode LX specific processor optimizations"
TUNE_CCARGS .= "${@bb.utils.contains('TUNE_FEATURES', 'geode', ' -march=geode', '', d)}"

# Extra tune selections
AVAILTUNES += "geode"
TUNE_FEATURES_tune-geode = "${TUNE_FEATURES_tune-x86} geode"
BASE_LIB_tune-geode = "lib"
TUNE_PKGARCH_tune-geode = "geode"
PACKAGE_EXTRA_ARCHS_tune-geode = "${PACKAGE_EXTRA_ARCHS_tune-x86} geode"
```
